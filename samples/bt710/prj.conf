## CMakeLists.txt
```
# SPDX-License-Identifier: Apache-2.0

cmake_minimum_required(VERSION 3.13.1)

include($ENV{ZEPHYR_BASE}/cmake/app/boilerplate.cmake NO_POLICY_SCOPE)
project(bt710)

FILE(GLOB app_sources src/*.c)
target_sources(app PRIVATE ${app_sources})
include_directories(${CMAKE_SOURCE_DIR}/include)


include_directories(${CMAKE_BINARY_DIR}/generated)
# END Include git info in build
```

## prj.conf
```kconfig
CONFIG_PINMUX=y
CONFIG_GPIO=y

# PWM
CONFIG_PWM_LOG_LEVEL_DBG=y

# PIEZO
CONFIG_PIEZO=y

# VIBEMOTOR
CONFIG_VIBEMOTOR=y

# LIS2DH Accel Sensor
CONFIG_ACCELEROMETER=y

# command line shell
CONFIG_SHELL=y
CONFIG_KERNEL_SHELL=y
CONFIG_DEVICE_SHELL=y
CONFIG_INIT_STACKS=y
CONFIG_STACK_SENTINEL=y
CONFIG_THREAD_MONITOR=y
CONFIG_THREAD_NAME=y

# turn on log system
CONFIG_LOG=y
CONFIG_LOG_BACKEND_UART=y
```

## src/main.c
```c
/*
 * Copyright (c) 2020 Laird Connectivity
 */

#include <zephyr.h>
#include <sys/printk.h>
#include <logging/log.h>
#include "version.h"
#include "workQueue.h"
#include "piezoThreadExample.h"
#include "vibeThreadExample.h"
#include "accelSample.h"

void main(void)
{
	printk("Laird Connectivity %s\n", CONFIG_BOARD);
	setup_work_queue();
	setup_piezo_thread();
	setup_vibe_thread();
	sample_accel();

	/* The shell runs a loop so don't loop anything here, do it in a thread */
}
```
